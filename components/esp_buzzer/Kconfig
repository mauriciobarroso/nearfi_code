## components/getbit_mqtt/Kconfig
```kconfig
menu "MQTT Configuration"

	config BITEC_MQTT_BROKER_URL
		string "MQTT broker URL"
		default "mqtts://a4bdl1178z00a-ats.iot.us-east-1.amazonaws.com:8883"
		help
    		URL for the MQTT broker. This must contain the number port and protol used.
    		
	config BITEC_MQTT_LWT_ENABLE
		bool "Enable LWT"
		default y
		help
			Enable LWT (Last Will and Testament).
			
	config BITEC_MQTT_LWT_TOPIC
		string "LWT topic"
		default "disconnected/"
		depends on BITEC_MQTT_LWT_ENABLE
		help
			Set LWT topic.
			
	config BITEC_MQTT_LWT_MESSAGE
		string "LWT message"
		default "disconnected"
		depends on BITEC_MQTT_LWT_ENABLE
		help
			Set LWT message.
			
	config BITEC_MQTT_LWT_QOS
		int "LWT QoS"
		default 0
		depends on BITEC_MQTT_LWT_ENABLE
		help
			Set LWT QoS.
        
	config BITEC_MQTT_LWT_LENGHT
		int "LWT message lenght"
		default 12
		depends on BITEC_MQTT_LWT_ENABLE
		help
			Set LWT message lenght.

endmenu
```

## main/Kconfig.projbuild
```kconfig
menu "NearFi Configuration"
menu "Application Configuration"
    config APP_RSSI_THRESHOLD_JOIN
        int "RSSI threshold join"
        default -35
        help
            Minimun RSSI threshold to join the network.

    config APP_RECONNECTION_TIME
        int "Reconnection time"
        default 20000
        help
            Time to try reconnection in ms.
endmenu

menu "OTA Configuration"
	config OTA_ENABLE
		bool "Enable OTA update"
		default n
		help
			Enable OTA firmware updates.

    config OTA_SERVER_CERT
        string "OTA firmware update server certificate"
        depends on OTA_ENABLE
        help
            Certificate to authenticate OTA server.

    config OTA_FILE_URL
        string "OTA firmware update URL"
        depends on OTA_ENABLE
        help
            URL for firmware update binary file.
endmenu

menu "Peripherals Configuration"
    config PERIPHERALS_LEDS_PIN
        int "LEDs pin"
        default 14
        help
            LEDs pin number.

    config PERIPHERALS_BUZZER_PIN
        int "Buzzer pin"
        default 1
        help
            Buzzer pin number.

    config PERIPHERALS_BUTTON_PIN
        int "Button pin"
        default 38
        help
            Button pin number.
            
    config PERIPHERALS_EWDT_WAKE_PIN
        int "External WDT wake pin"
        default 41
        help
            External WDT wake pin number.
            
    config PERIPHERALS_EWDT_DONE_PIN
        int "External WDT done pin"
        default 42
        help
            External WDT done pin number.
            
    config PERIPHERALS_I2C_SDA_PIN
        int "I2C SDA pin"
        default 39
        help
            I2C SDA pin number.
            
    config PERIPHERALS_I2C_SCL_PIN
        int "I2C SCL pin"
        default 40
        help
            I2C SCL pin number.
endmenu

menu "Wifi Configuration"
    config WIFI_AP_SSID
        string "AP SSID prefix"
        default "NearFi_" 
        help
            Access point SSID prefix.  This is concatenated with the MAC number to build the AP SSID.
            
    config WIFI_AP_CHANNEL
        int "AP channel"
        default 1
        help
            Access point target channel.
            
    config WIFI_AP_MAX_STA_CONN
        int "AP maximum connected clients"
        default 15
        help
            Maximum number of stations connected.

    config WIFI_PROV_SSID_PREFIX
        string "Provisioning SSID prefix"
        default "PROV_"
        help
        	Provisioning AP SSID prefix. This is concatenated with the MAC number to build the AP SSID.

endmenu
endmenu
```

## sdkconfig.defaults
```kconfig
CONFIG_MEMMAP_SMP=y
CONFIG_ESP_SYSTEM_EVENT_TASK_STACK_SIZE=4096
CONFIG_FREERTOS_HZ=1000
CONFIG_ESP_INT_WDT=n
CONFIG_ESP_TASK_WDT=n

#
# SPI RAM config
#
CONFIG_SPIRAM=y
CONFIG_SPIRAM_BOOT_INIT=y
CONFIG_SPIRAM_USE_CAPS_ALLOC=y
CONFIG_SPIRAM_USE_MALLOC=y
CONFIG_SPIRAM_TYPE_AUTO=y
CONFIG_SPIRAM_MODE_QUAD=y
CONFIG_SPIRAM_SIZE=-1
CONFIG_SPIRAM_SPEED_80M=y
CONFIG_SPIRAM_MEMTEST=y
CONFIG_SPIRAM_CACHE_WORKAROUND=y
CONFIG_SPIRAM_BANKSWITCH_ENABLE=y
CONFIG_SPIRAM_BANKSWITCH_RESERVE=8
CONFIG_SPIRAM_TRY_ALLOCATE_WIFI_LWIP=y

#
#
#
CONFIG_ESP_WIFI_SLP_IRAM_OPT=y

#
# LWIP
#
CONFIG_LWIP_IP_FORWARD=y
CONFIG_LWIP_IPV4_NAPT=y
CONFIG_LWIP_IRAM_OPTIMIZATION=y
CONFIG_LWIP_L2_TO_L3_COPY=y
CONFIG_LWIP_TCP_MSS=1460
CONFIG_LWIP_TCP_OVERSIZE_MSS=y
CONFIG_LWIP_DHCPS_MAX_STATION_NUM=64
CONFIG_LWIP_ETHARP_TRUST_IP_MAC=n
CONFIG_LWIP_IRAM_OPTIMIZATION=y
CONFIG_LWIP_IP_REASS_MAX_PBUFS=15
CONFIG_LWIP_TCPIP_TASK_PRIO=23
CONFIG_LWIP_TCPIP_CORE_LOCKING=y
CONFIG_LWIP_TCPIP_CORE_LOCKING_INPUT=y
CONFIG_LWIP_TCP_SND_BUF_DEFAULT=51200
CONFIG_LWIP_TCP_WND_DEFAULT=65535
CONFIG_LWIP_TCP_RECVMBOX_SIZE=64
CONFIG_LWIP_UDP_RECVMBOX_SIZE=64
CONFIG_LWIP_TCPIP_RECVMBOX_SIZE=64
CONFIG_LWIP_EXTRA_IRAM_OPTIMIZATION=y

#
# Partition Table
#
CONFIG_PARTITION_TABLE_CUSTOM=y
CONFIG_PARTITION_TABLE_CUSTOM_FILENAME="partitions.csv"
CONFIG_PARTITION_TABLE_FILENAME="partitions.csv"
CONFIG_PARTITION_TABLE_OFFSET=0x8000
CONFIG_PARTITION_TABLE_MD5=y
# end of Partition Table

#
# Bootloader config
#
CONFIG_BOOTLOADER_LOG_LEVEL_NONE=y
# end of Bootloader config

CONFIG_ESP_DEFAULT_CPU_FREQ_MHZ_240=y
CONFIG_ESPTOOLPY_FLASHSIZE_4MB=y
CONFIG_ESPTOOLPY_FLASHMODE_QIO=y
CONFIG_ESPTOOLPY_FLASHFREQ_80M=y

CONFIG_ESP_WIFI_ENABLE_WIFI_RX_STATS=n
CONFIG_ESP_WIFI_ENABLE_WIFI_TX_STATS=n
CONFIG_ESP_WIFI_TASK_PINNED_TO_CORE_1=y
CONFIG_ESP_WIFI_EXTRA_IRAM_OPT=y

# end of Component config
```

## sdkconfig.defaults.esp32c6
```kconfig
#
# ESP32C6-Specific
#
CONFIG_ESP_WIFI_STATIC_RX_BUFFER_NUM=40
CONFIG_ESP_WIFI_DYNAMIC_RX_BUFFER_NUM=60
CONFIG_ESP_WIFI_DYNAMIC_TX_BUFFER_NUM=40
CONFIG_ESP_WIFI_AMPDU_TX_ENABLED=y
CONFIG_ESP_WIFI_TX_BA_WIN=32
CONFIG_ESP_WIFI_AMPDU_RX_ENABLED=y
CONFIG_ESP_WIFI_RX_BA_WIN=32

CONFIG_LWIP_TCP_SND_BUF_DEFAULT=51200
CONFIG_LWIP_TCP_WND_DEFAULT=65535
CONFIG_LWIP_TCP_RECVMBOX_SIZE=64
CONFIG_LWIP_UDP_RECVMBOX_SIZE=64
CONFIG_LWIP_TCPIP_RECVMBOX_SIZE=64

CONFIG_PERIPHERALS_LEDS_PIN=8
CONFIG_PERIPHERALS_BUZZER_PIN=0
CONFIG_PERIPHERALS_BUTTON_PIN=9
CONFIG_PERIPHERALS_EWDT_WAKE_PIN=4
CONFIG_PERIPHERALS_EWDT_DONE_PIN=5
CONFIG_PERIPHERALS_I2C_SDA_PIN=6
CONFIG_PERIPHERALS_I2C_SCL_PIN=7
```

## sdkconfig.defaults.esp32s2
```kconfig
#
# ESP32S2-specific
#
CONFIG_ESP_WIFI_STATIC_RX_BUFFER_NUM=8
CONFIG_ESP_WIFI_DYNAMIC_RX_BUFFER_NUM=24
CONFIG_ESP_WIFI_DYNAMIC_TX_BUFFER_NUM=24
CONFIG_ESP_WIFI_AMPDU_TX_ENABLED=y
CONFIG_ESP_WIFI_TX_BA_WIN=16
CONFIG_ESP_WIFI_AMPDU_RX_ENABLED=y
CONFIG_ESP_WIFI_RX_BA_WIN=16

CONFIG_LWIP_TCP_SND_BUF_DEFAULT=28000
CONFIG_LWIP_TCP_WND_DEFAULT=28000
CONFIG_LWIP_TCP_RECVMBOX_SIZE=32
CONFIG_LWIP_UDP_RECVMBOX_SIZE=32
CONFIG_LWIP_TCPIP_RECVMBOX_SIZE=32

CONFIG_ESP32S2_INSTRUCTION_CACHE_16KB=y
CONFIG_ESP32S2_INSTRUCTION_CACHE_LINE_16B=y
CONFIG_ESP32S2_INSTRUCTION_CACHE_WRAP=y

CONFIG_SPIRAM=n

CONFIG_PERIPHERALS_LEDS_PIN=18
CONFIG_PERIPHERALS_BUZZER_PIN=1
CONFIG_PERIPHERALS_BUTTON_PIN=0
CONFIG_PERIPHERALS_EWDT_WAKE_PIN=4
CONFIG_PERIPHERALS_EWDT_DONE_PIN=5
CONFIG_PERIPHERALS_I2C_SDA_PIN=6
CONFIG_PERIPHERALS_I2C_SCL_PIN=7
```

## sdkconfig.defaults.esp32s3
```kconfig
# Default configurations for ESP32-S3

CONFIG_ESPTOOLPY_FLASHSIZE_4MB=y

CONFIG_ESP32S3_DEFAULT_CPU_FREQ_240=y
CONFIG_ESP32S3_SPIRAM_SUPPORT=y

CONFIG_ESP32S3_DATA_CACHE_64KB=y
CONFIG_ESP32S3_DATA_CACHE_8WAYS=y
CONFIG_ESP32S3_DATA_CACHE_LINE_64B=y

CONFIG_SPIRAM_MODE_QUAD=y

CONFIG_ESP32_WIFI_STATIC_RX_BUFFER_NUM=25
CONFIG_ESP32_WIFI_DYNAMIC_RX_BUFFER_NUM=64
CONFIG_ESP32_WIFI_DYNAMIC_TX_BUFFER_NUM=64
CONFIG_ESP32_WIFI_AMPDU_TX_ENABLED=y
CONFIG_ESP32_WIFI_TX_BA_WIN=32
CONFIG_ESP32_WIFI_AMPDU_RX_ENABLED=y
CONFIG_ESP32_WIFI_RX_BA_WIN=32

CONFIG_LWIP_TCP_SND_BUF_DEFAULT=65535
CONFIG_LWIP_TCP_WND_DEFAULT=65535
CONFIG_LWIP_TCP_RECVMBOX_SIZE=64
CONFIG_LWIP_UDP_RECVMBOX_SIZE=64
CONFIG_LWIP_TCPIP_RECVMBOX_SIZE=64

CONFIG_ESP_DEFAULT_CPU_FREQ_MHZ_240=y
CONFIG_ESP_DEFAULT_CPU_FREQ_MHZ=240

CONFIG_ESPTOOLPY_FLASHMODE_QIO=y
CONFIG_ESPTOOLPY_FLASHFREQ_80M=y

CONFIG_ESP32S3_INSTRUCTION_CACHE_32KB=y
CONFIG_ESP32S3_INSTRUCTION_CACHE_LINE_32B=y
CONFIG_ESP32S3_INSTRUCTION_CACHE_WRAP=y

CONFIG_ESP32_WIFI_TASK_PINNED_TO_CORE_1=y
```
